## conf/layer.conf
```bitbake
# We have a conf and classes directory, add to BBPATH
BBPATH .= ":${LAYERDIR}"

# We have recipes-* directories, add to BBFILES
BBFILES += "${LAYERDIR}/recipes-*/*/*.bb \
            ${LAYERDIR}/recipes-*/*/*.bbappend"

BBFILE_COLLECTIONS += "meta-arcelik-imx"
BBFILE_PATTERN_meta-arcelik-imx = "^${LAYERDIR}/"
BBFILE_PRIORITY_meta-arcelik-imx = "6"

LAYERDEPENDS_meta-arcelik-imx = "core"
LAYERSERIES_COMPAT_meta-arcelik-imx = "dunfell"
```

## conf/machine/imx8mnrvc.conf
```bitbake
#@TYPE: Machine
#@NAME: NXP i.MX8M Nano DDR4 RVC board
#@SOC: i.MX8MN
#@DESCRIPTION: Machine configuration for Arcelik RVC i.MX8M Nano DDR4 board

require conf/machine/include/rvcbase.conf

# Set Serial console if not already set
SERIAL_CONSOLES ?= "115200;ttymxc1"
```

## conf/machine/include/rvcbase.conf
```bitbake
#@TYPE: Machine include
#@NAME: NXP i.MX8M Nano based Arcelik boards
#@SOC: i.MX8MN

MACHINEOVERRIDES =. "mx8:mx8m:mx8mn:"

require conf/machine/include/imx-base.inc
require conf/machine/include/tune-cortexa53.inc

IMX_DEFAULT_BSP = "nxp"

MACHINE_FEATURES += "wifi bluetooth"

KERNEL_DEVICETREE = " \
	freescale/imx8mn-evk.dtb \
"

UBOOT_MACHINE = "imx8mn_arcelik_defconfig"
SPL_BINARY = "spl/u-boot-spl.bin"

# Set u-boot DTB
UBOOT_DTB_NAME = "imx8mn-ddr4-evk.dtb"

# Set imx-mkimage boot target, keep this around so that imx-boot builds
IMXBOOT_TARGETS = "flash_ddr4_evk"
WKS_FILE_DEPENDS_remove_mx8 = "imx-boot"
SOC_DEFAULT_WKS_FILE_mx8 = "imx-imx8mnrvc-boot-bootpart.wks.in"

# Set Serial console if not already set
SERIAL_CONSOLES ?= "115200;ttymxc1"

BOOT_SPACE = "65536"
LOADADDR = ""
UBOOT_SUFFIX = "bin"

# Image boot offset as defined in section 6.1.6.1 "Primary image offset and IVT offset" of
# i.MX 8M Nano Applications Processor Reference Manual, Rev. 0, 12/2019
# Doc ID: IMX8MNRM
IMX_BOOT_SEEK = "32"

OPTEE_BIN_EXT = "8mn"

#IMX_DEFAULT_BOOTLOADER = "u-boot-arcelik"
#PREFERRED_PROVIDER_virtual/bootloader ?= "u-boot-arcelik"
#PREFERRED_PROVIDER_u-boot ?= "u-boot-arcelik"
```
